## boards/riscv32/hifive1/Kconfig.board
```kconfig
config BOARD_HIFIVE1
	bool "HiFive1 target"
	depends on SOC_RISCV32_SIFIVE_FREEDOM
	select HAS_DTS
	select HAS_DTS_I2C
```

## boards/riscv32/hifive1/Kconfig.defconfig
```kconfig
if BOARD_HIFIVE1

config BOARD
	default "hifive1"

if PWM

config PWM_SIFIVE
	default y

endif

endif
```

## boards/riscv32/hifive1_revb/Kconfig.board
```kconfig
config BOARD_HIFIVE1_REVB
	bool "HiFive1 Rev B target"
	depends on SOC_RISCV32_SIFIVE_FREEDOM
```

## boards/riscv32/hifive1_revb/Kconfig.defconfig
```kconfig
if BOARD_HIFIVE1_REVB

config BOARD
	default "hifive1_revb"

config FLASH_BASE_ADDRESS
	default 0x20000000

config FLASH_LOAD_OFFSET
	default 0x10000

config HAS_FLASH_LOAD_OFFSET
	default y

config RISCV_ROM_BASE_ADDR
	default 0x20010000

config RISCV_ROM_SIZE
	default 0x3C0900

if PWM

config PWM_SIFIVE
	default y

endif

config HAS_DTS_I2C
	default y

endif
```

## boards/riscv32/sifive-sensors/Kconfig.board
```kconfig
config BOARD_SIFIVE_SENSORS
	bool "SiFive Sensors target"
	depends on SOC_RISCV32_SIFIVE_FREEDOM
	select HAS_DTS
	select HAS_DTS_I2C
	select HAS_DTS_I2C_DEVICE
	select HAS_DTS_SPI
```

## boards/riscv32/sifive-sensors/Kconfig.defconfig
```kconfig
if BOARD_SIFIVE_SENSORS

config BOARD
	default "sifive-sensors"

config RISCV_ROM_BASE_ADDR
	default 0x20010000

endif
```

## boards/riscv32/sifive-usermode/Kconfig.board
```kconfig
config BOARD_SIFIVE_USERMODE
	bool "SiFive target with user-mode"
	depends on SOC_RISCV32_SIFIVE_FREEDOM
	select HAS_DTS
```

## boards/riscv32/wunderboard/Kconfig.board
```kconfig
config BOARD_WUNDERBOARD
	bool "Wunderboard target"
	depends on SOC_RISCV32_SIFIVE_FREEDOM
	select HAS_DTS
```

## boards/riscv32/wunderboard/wunderboard_defconfig
```kconfig
CONFIG_RISCV32=y
CONFIG_SOC_SERIES_RISCV32_SIFIVE_FREEDOM=y
CONFIG_SOC_RISCV32_SIFIVE_FREEDOM=y
CONFIG_BOARD_WUNDERBOARD=y
CONFIG_CONSOLE=y
CONFIG_PRINTK=y
CONFIG_SERIAL=y
CONFIG_UART_SIFIVE=y
CONFIG_UART_SIFIVE_PORT_0=y
CONFIG_UART_CONSOLE=y
CONFIG_PLIC=y
CONFIG_PINMUX=y
CONFIG_PINMUX_SIFIVE=y
CONFIG_RISCV_MACHINE_TIMER=y
CONFIG_GPIO=y
CONFIG_GPIO_SIFIVE=y
CONFIG_BOOT_BANNER=y
CONFIG_WIFI_WINC1500=y
CONFIG_WIFI_WINC1500_REGION_EUROPE=y
CONFIG_WIFI_WINC1500_GPIO_SPI_CS=y
CONFIG_WIFI_WINC1500_GPIO_SPI_CS_DRV_NAME="GPIO_0"
CONFIG_WIFI_WINC1500_GPIO_SPI_CS_PIN=13

CONFIG_WINC1500_GPIO_DRV_NAME="GPIO_0"
CONFIG_WINC1500_GPIO_CHIP_EN=19
CONFIG_WINC1500_GPIO_IRQN=18
CONFIG_WINC1500_GPIO_RESET_N=26
```

## drivers/adc/Kconfig.ti_tla2024
```kconfig
# Kconfig - TLA2024 configuration

#
# Copyright (c) 2018 SiFive Inc.
#
# SPDX-License-Identifier: Apache-2.0
#

menuconfig ADC_TI_TLA2024
	bool "TI TLA2024 driver"
	depends on I2C
	help
	  Enable driver for TI's TLA2024 ADC chip

menu "Attributes"
	depends on ADC_TI_TLA2024

config TI_TLA2024_FS_RANGE
	int	"Full scale range of the TLA2024 ADC (mV)"
	default 6000
	help
	  Specify the full-scale range of the TLA2024 ADC in mV. Supported
	  values are 6000, 4000, 2000, 1000, 500, and 125 mV.

endmenu # Attributes
```

## drivers/display/Kconfig.sifive
```kconfig
# Kconfig - SiFive display driver

#
# Copyright (c) 2018 SiFive Inc.
#
# SPDX-License-Identifier: Apache-2.0
#

config SIFIVE_DISPLAY
	bool "SiFive 5x5 LED Display support"
	depends on GPIO
	help
		Enables the 5x5 LED array

if SIFIVE_DISPLAY

config SIFIVE_DISPLAY_PERIOD
	int "Period of one flash of the LEDs in us"
	default 1000

config SIFIVE_DISPLAY_ROW_0_GPIO_PIN
	int "GPIO pin number for row 0"
	default 23

config SIFIVE_DISPLAY_ROW_1_GPIO_PIN
	int "GPIO pin number for row 0"
	default 20

config SIFIVE_DISPLAY_ROW_2_GPIO_PIN
	int "GPIO pin number for row 0"
	default 18

config SIFIVE_DISPLAY_ROW_3_GPIO_PIN
	int "GPIO pin number for row 0"
	default 17

config SIFIVE_DISPLAY_ROW_4_GPIO_PIN
	int "GPIO pin number for row 0"
	default 16

config SIFIVE_DISPLAY_COL_0_GPIO_PIN
	int "GPIO pin number for column 0"
	default 22

config SIFIVE_DISPLAY_COL_0_PWM_DEV
	int "PWM Device number for column 0"
	default 1

config SIFIVE_DISPLAY_COL_0_PWM_CHAN
	int "PWM channel for column 0"
	default 3

config SIFIVE_DISPLAY_COL_1_GPIO_PIN
	int "GPIO pin number for column 1"
	default 21

config SIFIVE_DISPLAY_COL_1_PWM_DEV
	int "PWM Device number for column 1"
	default 1

config SIFIVE_DISPLAY_COL_1_PWM_CHAN
	int "PWM channel for column 1"
	default 2

config SIFIVE_DISPLAY_COL_2_GPIO_PIN
	int "GPIO pin number for column 2"
	default 19

config SIFIVE_DISPLAY_COL_2_PWM_DEV
	int "PWM Device number for column 2"
	default 1

config SIFIVE_DISPLAY_COL_2_PWM_CHAN
	int "PWM channel for column 2"
	default 1

config SIFIVE_DISPLAY_COL_3_GPIO_PIN
	int "GPIO pin number for column 3"
	default 2

config SIFIVE_DISPLAY_COL_3_PWM_DEV
	int "PWM Device number for column 3"
	default 0

config SIFIVE_DISPLAY_COL_3_PWM_CHAN
	int "PWM channel for column 3"
	default 2

config SIFIVE_DISPLAY_COL_4_GPIO_PIN
	int "GPIO pin number for column 4"
	default 1

config SIFIVE_DISPLAY_COL_4_PWM_DEV
	int "PWM Device number for column 4"
	default 0

config SIFIVE_DISPLAY_COL_4_PWM_CHAN
	int "PWM channel for column 4"
	default 1


endif # SIFIVE_DISPLAY
```

## drivers/pwm/Kconfig.sifive
```kconfig
# Kconfig.sifive - SiFive Freedom PWM configuration options
#
#
# Copyright (c) 2018 SiFive Inc.
#
# SPDX-License-Identifier: Apache-2.0
#

menuconfig PWM_SIFIVE
	bool "SiFive Freedom PWM driver"
	depends on PWM
	depends on SOC_SERIES_RISCV32_SIFIVE_FREEDOM
	depends on HAS_DTS
	help
		Enable the PWM driver for the SiFive Freedom platform

if PWM_SIFIVE

config PWM_SIFIVE_INIT_PRIORITY
	int "Init Priority"
	default 80
	help
		SiFive PWM Driver Initialization Priority

config PWM_SIFIVE_CMPWIDTH
	int "Compare width"
	default 16
	help
		PWM Peripheral compare width

endif # PWM_SIFIVE
```

## drivers/sensor/lsm303c/Kconfig
```kconfig
# Kconfig - LSM303C accelerometer, magnetometer, and temperature sensor
# options

#
# Copyright (c) 2016 Intel Corporation
# Copyright (c) 2018 SiFive Inc.
#
# SPDX-License-Identifier: Apache-2.0
#

menuconfig LSM303C
	bool "LSM303C I2C accelerometer, magnetometer, and temperature sensor"
	depends on I2C
	help
	  Enable driver for LSM303C I2C-based accelerometer, magnetometer, and
	  temperature sensor.

config LSM303C_M_I2C_ADDR
	hex "LSM303C I2C address"
	depends on LSM303C
	default 0x3C
	help
	  I2C address of the LSM303C sensor.

config LSM303C_ACCEL_ENABLE_X_AXIS
	bool "Enable accelerometer X axis"
	depends on LSM303C
	default y
	help
	  Enable/disable accelerometer X axis totally by stripping everything
	  related in driver.

config LSM303C_ACCEL_ENABLE_Y_AXIS
	bool "Enable accelerometer Y axis"
	depends on LSM303C
	default y
	help
	  Enable/disable accelerometer Y axis totally by stripping everything
	  related in driver.

config LSM303C_ACCEL_ENABLE_Z_AXIS
	bool "Enable accelerometer Z axis"
	depends on LSM303C
	default y
	help
	  Enable/disable accelerometer Z axis totally by stripping everything
	  related in driver.

config LSM303C_MAGN_ENABLE_X_AXIS
	bool "Enable magnetometer X axis"
	depends on LSM303C
	default y
	help
	  Enable/disable magnetometer X axis totally by stripping everything
	  related in driver.

config LSM303C_MAGN_ENABLE_Y_AXIS
	bool "Enable magnetometer Y axis"
	depends on LSM303C
	default y
	help
	  Enable/disable magnetometer Y axis totally by stripping everything
	  related in driver.

config LSM303C_MAGN_ENABLE_Z_AXIS
	bool "Enable magnetometer Z axis"
	depends on LSM303C
	default y
	help
	  Enable/disable magnetometer Z axis totally by stripping everything
	  related in driver.

config LSM303C_ENABLE_TEMP
	bool "Enable temperature"
	depends on LSM303C
	default y
	help
	  Enable/disable temperature totally by stripping everything related in
	  driver.

menu "Attributes"
	depends on LSM303C

config LSM303C_MAGN_SAMPLING_RATE
	int "Output data rate"
	depends on LSM303C
	default 80
	help
	  Specify the default magnetometer output data rate expressed in samples
	  per second (Hz).
	  Data rates supported by the chip are 0.625, 1.25, 2.5, 5, 10, 20, 40, and
	  80.

config LSM303C_ACCEL_FULLSCALE
	int "Accelerometer full-scale range"
	depends on LSM303C
	default 4
	help
	  Specify the default accelerometer full-scale range.
	  An X value for the config represents a range of +/- X G. Valid values
	  are 2, 4, and 8.

config LSM303C_ACCEL_SAMPLING_RATE
	int "Output data rate"
	depends on LSM303C
	default 800
	help
	  Specify the default accelerometer output data rate expressed in
	  samples per second (Hz).
	  Data rates supported by the chip are 0 (off), 10, 50, 100, 200, 400,
	  and 800.

endmenu
```

## drivers/sensor/ltr329/Kconfig
```kconfig
# Kconfig - LTR329 Light Sensor Options

#
# Copyright (c) 2018 SiFive Inc.
#
# SPDX-License-Identifier: Apache-2.0
#

menuconfig LTR329
	bool "LTR329 Light Sensor"
	depends on I2C
	help
	  Enable driver for LTR329 I2C-based light sensor.

menu "Attributes"
	depends on LTR329

config LTR329_GAIN
	int "Light sensor gain setting"
	default 96
	help
		Specify the light sensor gain setting.
		Valid values are 1, 2, 4, 8, 48, and 96.

config LTR329_INTEG_RATE
	int "Light sensor integration rate (ms)"
	default 50
	help
		Specify the light sensor integration rate setting in ms. Must be
		less than the sample rate. Valid values are 50, 100, 150, 200,
		250, 300, 350, and 400.

config LTR329_MEAS_RATE
	int "Light sensor sample rate (ms)"
	default 100
	help
		Specify the light sensor sample rate setting in ms. Must be
		greater than the integration rate. Valid values are 50, 100,
		200, 500, 1000, and 2000.

endmenu
```

## dts/bindings/adc/ti,tla2024.yaml
```yaml
#
# Copyright (c) 2018, SiFive, Inc.
#
# SPDX-License-Identifier: Apache-2.0
#
---
title: TI TLA2024 ADC
id: ti,tla2024
version: 0.1

description: >
    This is the binding for the TI TLA2024 Analog-to-Digital Converter

inherits:
    !include i2c-device.yaml

properties:
    compatible:
        constraint: "ti,tla2024"

...
```

## dts/bindings/sensor/liteon,ltr329.yaml
```yaml
#
# Copyright (c) 2018, SiFive Inc.
#
# SPDX-License-Identifier: Apache-2.0
#
---
title: LiteOn LTR-329 Light Sensor
id: liteon,ltr329
version: 0.1

description: >
    This binding gives a base representation of LTR-329 Light Sensor

inherits:
    !include i2c-device.yaml

properties:
    compatible:
      constraint: "liteon,ltr329"

...
```

## dts/bindings/sensor/st,lsm303c.yaml
```yaml
#
# Copyright (c) 2018, SiFive Inc.
#
# SPDX-License-Identifier: Apache-2.0
#
---
title: STMicroelectronics MEMS sensors LSM303C
id: st,lsm303c
version: 0.1

description: >
    This binding gives a base representation of LSM303C accelerometer,
    magnetometer, and temperature sensor

inherits:
    !include i2c-device.yaml

properties:
    compatible:
      constraint: "st,lsm303c"

...
```

## soc/riscv32/riscv-privilege/Kconfig
```kconfig
# Kconfig - configuration options for riscv SOCs supporting
#           the riscv privileged architecture specification
#
# Copyright (c) 2017 Jean-Paul Etienne <fractalclone@gmail.com>
#
# SPDX-License-Identifier: Apache-2.0
#

config SOC_FAMILY_RISCV_PRIVILEGE
	bool
	# omit prompt to signify a "hidden" option

config SOC_FAMILY
	string
	default "riscv-privilege"
	depends on SOC_FAMILY_RISCV_PRIVILEGE

config RISCV_HAS_PLIC
	bool "Does the SOC provide support for a Platform Level Interrupt Controller"
	depends on SOC_FAMILY_RISCV_PRIVILEGE
	help
	  Does the SOC provide support for a Platform Level Interrupt Controller

config RISCV_HAS_USER_MODE
	bool "Does the SOC provide support for user-mode privileged execution"
	select ARCH_HAS_USERSPACE
	help
	  The RISC-V Privileged Archeticture Specification provides optional
	  support for a reduced-privilege user mode of execution. If this option
	  is selected by a SoC, then it supports Zephyr's User Mode features
	  enabled by CONFIG_USERSPACE.

source "soc/riscv32/riscv-privilege/*/Kconfig.soc"
```
